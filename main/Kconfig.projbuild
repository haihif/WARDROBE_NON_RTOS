## main/Kconfig.projbuild
```kconfig
menu "Device in use" 

    config NAME_DEVICE
        string "Name Device"
        default "Wardrobe"
        help
            Name device.

    config FIRMWARE_VERSION
        string "Firmware version"
        default "0.0.1"
        help 
            Firmware version.

    config USING_WIFI
        bool "Using WIFI station"
        default y
        help 
            Using connect WIFI.

    config USING_BME280
        bool "Using BME280 Sensor"
        default y
        help 
            Using BME280 sensor.


endmenu

menu "WiFi Config Menu"

    config SSID
        string  "SSID"
        default "***"
        help
            SSID.

    config PASSWORD
        string  "PASSWORD"
        default  "***"
        help 
            PASSWORD.

    config MAXIMUM_AP
        int "Maximum access points"
        default  10
        help 
            Maximum access points.

    config MAXIMUM_RETRY
        int "Maximum retry"
        default 25
        help
            Set the Maximum retry to avoid station reconnecting to the AP unlimited when the AP is really inexistent.

    config SHOW_LIST_ACCESS_POINTS_FOUND
        bool "Show list Access Points found."
        default y
        help
            Show list Access Points found.

endmenu
```
